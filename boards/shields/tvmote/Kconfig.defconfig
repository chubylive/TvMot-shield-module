## boards/shields/tvmote/Kconfig.defconfig
```kconfig
# Copyright (c) 2020 The ZMK Contributors
# SPDX-License-Identifier: MIT

if SHIELD_TVMOTE

config ZMK_KEYBOARD_NAME
    default "tvmote"

endif
```

## boards/shields/tvmote/Kconfig.shield
```kconfig
# Copyright (c) 2020 The ZMK Contributors
# SPDX-License-Identifier: MIT

config SHIELD_TVMOTE
    def_bool $(shields_list_contains,tvmote)
```
